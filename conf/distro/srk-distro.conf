## conf/distro/srk-distro.conf
```bitbake
# Custom Distribution Configuration
# home/srk2cob/project/poky/meta-poky/conf/distro/poky-tiny.conf
DISTRO = "srk-distro"
DISTRO_NAME = "SRK  Distro"
DISTRO_VERSION = "1.0"

# Define the default provider for the C library
PREFERRED_PROVIDER_virtual/libc = "glibc"

# Define the init manager
VIRTUAL-RUNTIME_init_manager = "busybox"

# Define the package manager
# PACKAGE_CLASSES = "package_rpm"

# Define the distribution features
DISTRO_FEATURES:remove = " systemd"
DISTRO_FEATURES:remove = " x11"

# Define the default tune
DEFAULTTUNE = "armv7at-neon"

# Additional configurations

# Global size optimization flags (Step 12 experiment)
TARGET_CFLAGS:append = " -Os -fdata-sections -ffunction-sections"
TARGET_CXXFLAGS:append = " -Os -fdata-sections -ffunction-sections"
LDFLAGS:append = " -Wl,--gc-sections"

# Prefer smaller debug info / strip aggressively in images
INHIBIT_PACKAGE_STRIP = "0"
PACKAGE_DEBUG_SPLIT_STYLE = "debug-without-src"

# Ensure reproducibility considerations: keep deterministic archives
ARFLAGS:append = " D"
```

## conf/distro/srk-minimal-squashfs-distro.conf
```bitbake
# --------------------------------------------------------------------
# SRK Minimal SquashFS Distro
#
# This distribution provides a lightweight, reproducible base system
# for embedded devices that require:
#
# ✅ systemd as init system
# ✅ usrmerge support
# ✅ squashfs-based root filesystem
#
# ❌ Excludes:
#    - sysvinit (legacy init system)
#    - kernel and U-Boot packages (handled separately / not part of rootfs)
#
# Goal:
#   Provide a minimal userland-focused image for squashfs-based
#   embedded systems, without bootloader or kernel artifacts.
# --------------------------------------------------------------------

DISTRO = "srk-minimal-squashfs-distro"
DISTRO_NAME = "SRK Minimal SquashFS Distro"
DISTRO_VERSION = "1.0"

# System features
DISTRO_FEATURES:append = " systemd usrmerge"
DISTRO_FEATURES:remove = " sysvinit package-management"

# Init system
VIRTUAL-RUNTIME_init_manager = "systemd"

# Build dependencies - remove unnecessary components for embedded squashfs images
EXTRA_IMAGEDEPENDS:remove = " virtual/bootloader qemu-native qemu-helper-native"
```

## conf/layer.conf
```bitbake
# We have a conf and classes directory, add to BBPATH
BBPATH .= ":${LAYERDIR}"

# We have recipes-* directories, add to BBFILES
BBFILES += "${LAYERDIR}/recipes-*/*/*.bb \
            ${LAYERDIR}/recipes-*/*/*.bbappend"

BBFILE_COLLECTIONS += "meta-srk"
BBFILE_PATTERN_meta-srk = "^${LAYERDIR}/"
BBFILE_PRIORITY_meta-srk = "6"

LAYERDEPENDS_meta-srk = "core"
LAYERSERIES_COMPAT_meta-srk = "styhead walnascar"

# PREFERRED_PROVIDER_virtual/kernel = "linux-yocto-srk"
```

## conf/machine/raspberrypi-zero.conf
```bitbake
#@TYPE: Machine
#@NAME: Raspberry Pi Zero machine
#@DESCRIPTION: Machine configuration for Raspberry Pi Zero (BCM2835)

PREFERRED_PROVIDER_virtual/xserver ?= "xserver-xorg"

MACHINE_EXTRA_RRECOMMENDS = "kernel-modules"

EXTRA_IMAGEDEPENDS += "virtual/bootloader"

# BCM2835 (ARM1176JZF-S single core)
DEFAULTTUNE ?= "arm1176jzfshf"
include conf/machine/include/arm/armv6/tune-arm1176jzf-s.inc

# Image formats
IMAGE_FSTYPES += "tar.bz2 ext3 wic wic.bmap rpi-sdimg"
WKS_FILE ?= "rpi.wks"

# Boot configuration
KERNEL_IMAGETYPE = "zImage"
KERNEL_BOOTCMD = "bootz"
KERNEL_DEVICETREE = "bcm2708-rpi-zero.dtb bcm2708-rpi-zero-w.dtb"

# Serial console
SERIAL_CONSOLES ?= "115200;ttyS0 115200;ttyAMA0"

# Boot loader
PREFERRED_PROVIDER_virtual/bootloader = "rpi-config"

# GPU memory split
GPU_MEM = "16"

# Enable UART
ENABLE_UART = "1"

# WiFi firmware (for Pi Zero W)
MACHINE_FEATURES += "wifi bluetooth"

# Override various features
MACHINE_FEATURES = "kernel26 apm usbgadget usbhost vfat ext2 alsa bluetooth wifi"

# Disable features not needed for headless operation
MACHINE_FEATURES:remove = "screen touchscreen"

# Essential packages
MACHINE_ESSENTIAL_EXTRA_RDEPENDS += "kernel-image kernel-devicetree"

# Additional packages for Pi Zero
MACHINE_EXTRA_RRECOMMENDS += "\
    pi-blaster \
    wiringpi \
    rpi-gpio \
"

# U-Boot support (optional)
# PREFERRED_PROVIDER_virtual/bootloader = "u-boot"
# UBOOT_MACHINE = "rpi_defconfig"

# Video
# VC4DTBO = "vc4-kms-v3d"

# SPI and I2C support
MACHINE_FEATURES += "spi i2c"

# Overclock settings (optional)
# ARM_FREQ = "1000"
# CORE_FREQ = "500"
# SDRAM_FREQ = "500"
# OVER_VOLTAGE = "6"
```

## recipes-kernel/linux/linux-yocto-srk-tiny/defconfig
```kconfig
#
# Minimal BeagleBone Hello-World Kernel Config
#

CONFIG_LOCALVERSION="-yocto-hello"
CONFIG_LOCALVERSION_AUTO=n

# --- Platform (AM335x) ---
CONFIG_ARCH_OMAP2PLUS=y
CONFIG_SOC_AM33XX=y

# --- Boot options ---
CONFIG_EXPERT=y
CONFIG_INIT_ENV_ARG_LIMIT=4
CONFIG_BLK_DEV_INITRD=y


# --- Memory / devtmpfs ---
CONFIG_DEVTMPFS=y
CONFIG_DEVTMPFS_MOUNT=y
CONFIG_TMPFS=y

# --- Console ---
CONFIG_PRINTK=y
CONFIG_EARLY_PRINTK=y
CONFIG_SERIAL_8250=y
CONFIG_SERIAL_8250_CONSOLE=y
CONFIG_SERIAL_8250_OMAP=y

# --- Filesystems ---
CONFIG_EXT2_FS=y
# CONFIG_EXT4_FS is not set
# CONFIG_BTRFS_FS is not set
# CONFIG_FAT_FS is not set
# CONFIG_NFS_FS is not set
# CONFIG_CIFS is not set
# CONFIG_FUSE_FS is not set

# --- Disable networking ---
# CONFIG_NET is not set

# --- Disable USB / storage / multimedia ---
# CONFIG_USB is not set
# CONFIG_SOUND is not set
# CONFIG_DRM is not set
# CONFIG_MMC is not set

# --- Explicitly disable SCSI and related options ---
# CONFIG_SCSI is not set

# --- Disable security / crypto / namespaces ---
# CONFIG_SECURITY is not set
# CONFIG_KEYS is not set
# CONFIG_CRYPTO is not set
# CONFIG_NAMESPACES is not set
# CONFIG_CGROUPS is not set
# CONFIG_BPF_SYSCALL is not set

# --- Debugging (optional, can disable later) ---
CONFIG_DEBUG_KERNEL=y
CONFIG_KALLSYMS=y
```
